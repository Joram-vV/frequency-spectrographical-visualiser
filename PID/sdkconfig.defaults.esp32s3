## PID/sdkconfig.defaults.esp32s3
```kconfig
# ESP32-S3-DevKitC v1.1 uses GPIO38 for the on-board LED in the blink example.
# For this fan project, set your fan control GPIO here.
CONFIG_FAN_GPIO=38
```

## fan_1/main/Kconfig.projbuild
```kconfig
menu "Fan Configuration"

    orsource "$IDF_PATH/examples/common_components/env_caps/$IDF_TARGET/Kconfig.env_caps"

    config FAN_GPIO
        int "Fan PWM GPIO number"
        range ENV_GPIO_RANGE_MIN ENV_GPIO_OUT_RANGE_MAX
        default 2
        help
            GPIO number (IOxx) connected to the fan control input, gate driver, or transistor.

    config FAN_PWM_FREQ_HZ
        int "Fan PWM frequency (Hz)"
        range 1 50000
        default 25000
        help
            PWM frequency used for fan speed control. 25 kHz is common for 4-wire PC fans.

    config FAN_UPDATE_PERIOD_MS
        int "Fan speed update period (ms)"
        range 10 60000
        default 1000
        help
            Delay between speed changes in the demo loop.

    config FAN_ACTIVE_LOW
        bool "Invert fan PWM output (active low)"
        default n
        help
            Enable this if your fan driver/transistor stage is active low.

endmenu
```

## poging3000/sdkconfig.defaults
```kconfig
CONFIG_SPIRAM=y
CONFIG_SPIRAM_MODE_OCT=y
CONFIG_SPIRAM_SPEED_80M=y
CONFIG_SPIRAM_XIP_FROM_PSRAM=y
CONFIG_ESP_TASK_WDT_TIMEOUT_S=15
CONFIG_LV_BUILD_EXAMPLES=n
CONFIG_LV_FONT_MONTSERRAT_46=y
CONFIG_LV_FONT_MONTSERRAT_48=y
```
